/*
 * Copyright (c) 2021 Casey Webster
 *
 * SPDX-License-Identifier: MIT
 */

#include "tbkmini.dtsi"

&default_transform {
  col-offset = <5>;
};

&kscan0 {
	col-gpios
		= <&pro_micro 18 (GPIO_ACTIVE_LOW | GPIO_PULL_UP)>
		, <&pro_micro 15 (GPIO_ACTIVE_LOW | GPIO_PULL_UP)>
		, <&pro_micro 14 (GPIO_ACTIVE_LOW | GPIO_PULL_UP)>
		, <&pro_micro 16 (GPIO_ACTIVE_LOW | GPIO_PULL_UP)>
		, <&pro_micro 10 (GPIO_ACTIVE_LOW | GPIO_PULL_UP)>
		;
};
